## src/cpu/intel/model_65x/Kconfig
```kconfig
config CPU_INTEL_MODEL_65X
	bool
	select ARCH_X86
	select ARCH_ALL_STAGES_X86_32 if !EXPERIMENTAL_X86_64
	select ARCH_ALL_STAGES_X86_64 if EXPERIMENTAL_X86_64
	select SUPPORT_CPU_UCODE_IN_CBFS
```

## src/cpu/intel/model_68x/Kconfig
```kconfig
## SPDX-License-Identifier: GPL-2.0-or-later

config CPU_INTEL_MODEL_68X
	bool
	select ARCH_X86
	select ARCH_ALL_STAGES_X86_32 if !EXPERIMENTAL_X86_64
	select ARCH_ALL_STAGES_X86_64 if EXPERIMENTAL_X86_64
	select SUPPORT_CPU_UCODE_IN_CBFS
```
